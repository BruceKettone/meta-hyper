## conf/layer.conf
```bitbake
BBPATH .= ":${LAYERDIR}"

BBFILES += "${LAYERDIR}/recipes-*/*/*.bb \
            ${LAYERDIR}/recipes-*/*/*.bbappend"

BBFILE_COLLECTIONS += "meta-hyper"
BBFILE_PATTERN_meta-hyper = "^${LAYERDIR}/"
BBFILE_PRIORITY_meta-hyper = "6"

LAYERDEPENDS_meta-hyper = "core"
LAYERSERIES_COMPAT_meta-hyper = "wrynose"
```

## conf/machine/lkvm-arm64.conf
```bitbake
require conf/machine/qemuarm64.conf
SERIAL_CONSOLES = "115200;ttyS0"
KMACHINE = "qemuarm64"

SERIAL_CONSOLES = "115200;ttyS0 38400;hvc0 38400;tty1"
```
